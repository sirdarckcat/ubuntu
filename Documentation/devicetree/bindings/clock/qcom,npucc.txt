## Documentation/devicetree/bindings/clock/qcom,npucc.txt
```
Qualcomm Technologies, Inc. NPU Clock & Reset Controller Binding
----------------------------------------------------------------

Required properties :
- compatible : must contain "qcom,npucc-sm8150".
- reg : shall contain base register location and length.
- #clock-cells : shall contain 1.
- #reset-cells : shall contain 1.
- #power-domain-cells : shall contain 1.

Example:
	npucc: clock-controller@9910000 {
		compatible = "qcom,npucc-sm8150";
		reg = <0x0 0x09910000 0x0 0x10000>;
		reg-names = "cc_base";
		#clock-cells = <1>;
		#reset-cells = <1>;
		#power-domain-cells = <1>;
	};
```

## Documentation/devicetree/bindings/i2c/mellanox,i2c-mlxbf.yaml
```yaml
# SPDX-License-Identifier: (GPL-2.0-only OR BSD-2-Clause)
%YAML 1.2
---
$id: http://devicetree.org/schemas/i2c/mellanox,i2c-mlxbf.yaml#
$schema: http://devicetree.org/meta-schemas/core.yaml#

title: Mellanox I2C SMBus on BlueField SoCs

maintainers:
  - Khalil Blaiech <kblaiech@nvidia.com>
  - Asmaa Mnebhi <asmaa@nvidia.com>

allOf:
  - $ref: /schemas/i2c/i2c-controller.yaml#

properties:
  compatible:
    enum:
      - mellanox,i2c-mlxbf1
      - mellanox,i2c-mlxbf2
      - mellanox,i2c-mlxbf3

  reg:
    minItems: 5
    maxItems: 6
    items:
      - description: Smbus timer registers
      - description: Smbus master registers
      - description: Smbus slave registers
      - description: Cause master registers
      - description: Cause slave registers
      - description: Cause coalesce registers

  interrupts:
    maxItems: 1

  clock-frequency:
    enum: [ 100000, 400000, 1000000 ]
    description:
      bus frequency used to configure timing registers;
      The frequency is expressed in Hz. Default is 100000.

required:
  - compatible
  - reg
  - interrupts

unevaluatedProperties: false

if:
  properties:
    compatible:
      contains:
        enum:
          - mellanox,i2c-mlxbf1

then:
  properties:
    reg:
      maxItems: 3

examples:
  - |
    i2c@2804000 {
        compatible = "mellanox,i2c-mlxbf1";
        reg = <0x02804000 0x40>,
              <0x02804200 0x200>,
              <0x02804400 0x200>,
              <0x02801200 0x020>,
              <0x02801260 0x020>;
        interrupts = <57>;
        clock-frequency = <100000>;
    };

  - |
    i2c@2808800 {
        compatible = "mellanox,i2c-mlxbf2";
        reg = <0x02808800 0x40>,
              <0x02808a00 0x200>,
              <0x02808c00 0x200>,
              <0x02808e00 0x020>,
              <0x02808e20 0x020>,
              <0x02808e40 0x010>;
        interrupts = <57>;
        clock-frequency = <400000>;
    };

  - |
    i2c@2808800 {
        compatible = "mellanox,i2c-mlxbf3";
        reg = <0x13404480 0x40>,
              <0x13404200 0x200>,
              <0x13404000 0x200>,
              <0x13404400 0x020>,
              <0x13404420 0x020>,
              <0x13404440 0x010>;
        interrupts = <35>;
        clock-frequency = <400000>;
    };
```

## Documentation/devicetree/bindings/media/i2c/onnn,ar1335.yaml
```yaml
# SPDX-License-Identifier: (GPL-2.0-only OR BSD-2-Clause)
%YAML 1.2
---
$id: http://devicetree.org/schemas/media/i2c/onnn,ar1335.yaml#
$schema: http://devicetree.org/meta-schemas/core.yaml#

title: AR1335 1/3.2‐Inch 13 Mp CMOS Digital Image Sensor 

maintainers:
  - Anil Kumar M <anil.mamidala@amd.com>

description: |-
  The AR1335 from ON Semiconductor is a 1/3.2-inch BSI (Back Side Illuminated)
  CMOS active-pixel digital image sensor with a pixel array of 4208 (H) × 3120 (V).
  It is programmable through I2C interface. Image data is sent through MIPI CSI-2, 
  serial data lanes.

properties:
  compatible:
    const: ar1335 

  reg:
    description: I2C device address
    maxItems: 1

  clocks:
    maxItems: 1

  reset-gpios:
    maxItems: 1
    description: |-
      Reference to the GPIO connected to the reset pin.

  port:
    $ref: /schemas/graph.yaml#/$defs/port-base
    unevaluatedProperties: false
    description: MIPI CSI-2 output interface to the host.

    properties:
      clock-lanes:
        description: |-
          lane for extrenal clock.

      data-lanes:
        description: |-
          Two, three and four-lane supported, for four-lane operation the 
          property must be set to <1 2 3 4>.
        oneOf:
          - items:
              - const: 1
              - const: 1
          - items:
              - const: 1
              - const: 2
              - const: 2
          - items:
              - const: 1
              - const: 2
              - const: 3
              - const: 4

        required:
          - data-lanes
          - clock-lanes

      endpoint:
        $ref: /schemas/graph.yaml#/$defs/endpoint-base
        unevaluatedProperties: false

required:
  - compatible
  - reg
  - port

additionalProperties: false

examples:
  - |
    i2c0 {
        #address-cells = <1>;
        #size-cells = <0>;

        ar1335: sensor@36 {
            compatible = "ar1335";
            reg = <0x36>;
            reset-gpios = <&axi_gpio 2 0>;

            port {
                clock-lanes = <0>;
                data-lanes = <1 2 3 4>;
                ar1335_out: endpoint {
                    remote-endpoint = <&csi_ep>;
                };
            };
        };
    };

...
```

## drivers/gpu/drm/rp1-dsi/Kconfig
```kconfig
# SPDX-License-Identifier: GPL-2.0-only
config DRM_RP1_DSI
	tristate "DRM Support for RP1 DSI"
	depends on DRM
	select MFD_RP1
	select DRM_KMS_HELPER
	select DRM_VRAM_HELPER
	select DRM_TTM
	select DRM_TTM_HELPER
	help
	  Choose this option to enable DSI display on RP1
```

## drivers/media/platform/bcm2712/Kconfig
```kconfig
config VIDEO_BCM2712_PISP_BE
	tristate "BCM2712 PiSP Backend (BE) ISP driver"
	depends on VIDEO_DEV
	select VIDEO_V4L2_SUBDEV_API
	select MEDIA_CONTROLLER
	select VIDEOBUF2_DMA_CONTIG
	select V4L2_FWNODE
	help
	  Say Y here to enable support for the PiSP Backend (BE) ISP driver.

	  To compile this driver as a module, choose M here. The module will be
	  called bcm2712-pisp-be.
```

## drivers/misc/qed-pwr/Kconfig
```kconfig
#
# QED power driver
#
menu "QED power driver for 4G, bluetooth, wifi, and vsc"
config QED_BTWIFI_PWR
       default n
       tristate "QED Telit 4G, bluetooth, wifi, and vsc support"
config QED_BTWIFI_PWR_COMPLIANCE_TEST
       default n
       tristate "QED Telit 4G module compilence test"
endmenu
```

## drivers/misc/qedfs/Kconfig
```kconfig
#
# QED power driver
#
menu "QED driver for accessing QED serial number"
config QED_FS
       default n
       bool "QED serial number in sysfs"
       help
               Enable this option to support misc QED info in sysfs.
               Currently, there is only support for providing the board
               serial number under /sys/kernel/qedfs/qed_serialno.
endmenu
```

## drivers/misc/spi_fpga/Kconfig
```kconfig
#
# FPGA control spi driver
#
menu "FPGA control spi driver"
config FPGA_ARMCTL
       default n
       tristate "FPGA control ARM side support"
       depends on SPI_QUP

endmenu
```

## drivers/platform/mellanox/mlxbf_pka/Kconfig
```kconfig
# SPDX-License-Identifier: GPL-2.0
#
# Platform support for Mellanox BlueField PKA
#

config MLXBF_PKA
        tristate "Mellanox BlueField Public Key Accelerator driver"
        depends on ARM64 && IOMMU_API && VFIO_IOMMU_TYPE1 && VFIO_PLATFORM
        help
          If you say yes to this option, support will be included for the
          Public Key Accelerator device on Mellanox BlueField SoCs.

          This driver can also be built as a module.  If so, the module will
          be called pka-mlxbf.
```

## meta-files/image-zynqmp.its
```
/*
 * Simple U-Boot uImage source file containing a single kernel, ramdisk and FDT blob
 */

/dts-v1/;

/ {
    description = "Simple image with single Linux kernel, ramdisk and FDT blob";
    #address-cells = <1>;

    images {
        kernel-1 {
            description = "Ubuntu kernel";
            data = /incbin/("../Image.gz-5.15.39");
            type = "kernel";
            arch = "arm64";
            os = "linux";
            compression = "gzip";
            load = <0x00200000>;
            entry = <0x00200000>;
            hash-1 {
                algo = "sha1";
            };
        };
        ramdisk-1 {
            description = "Ubuntu ramdisk";
            data = /incbin/("../initrd.img");
            type = "ramdisk";
            arch = "arm64";
            os = "linux";
            compression = "none";
            hash-1 {
                algo = "sha1";
            };
        };
        fdt-zynqmp-smk-k26-revA.dtb {
            description = "Flattened device tree blob - zynqmp-smk-k26-revA";
            data = /incbin/("../dtbs/xilinx/zynqmp-smk-k26-revA.dtb");
            type = "flat_dt";
            arch = "arm64";
            compression = "none";
            load = <0x44000000>;
            hash-1 {
                algo = "sha1";
            };
        };
        fdt-smk-k26-revA-sck-kr-g-revA.dtb {
            description = "Flattened device tree blob - smk-k26-revA-sck-kr-g-revA";
            data = /incbin/("../dtbs/xilinx/smk-k26-revA-sck-kr-g-revA.dtb");
            type = "flat_dt";
            arch = "arm64";
            compression = "none";
            load = <0x44000000>;
            hash-1 {
                algo = "sha1";
            };
        };
        fdt-smk-k26-revA-sck-kv-g-revA.dtb {
            description = "Flattened device tree blob - smk-k26-revA-sck-kv-g-revA";
            data = /incbin/("../dtbs/xilinx/smk-k26-revA-sck-kv-g-revA.dtb");
            type = "flat_dt";
            arch = "arm64";
            compression = "none";
            load = <0x44000000>;
            hash-1 {
                algo = "sha1";
            };
        };
        fdt-smk-k26-revA-sck-kr-g-revB.dtb {
            description = "Flattened device tree blob - smk-k26-revA-sck-kr-g-revB";
            data = /incbin/("../dtbs/xilinx/smk-k26-revA-sck-kr-g-revB.dtb");
            type = "flat_dt";
            arch = "arm64";
            compression = "none";
            load = <0x44000000>;
            hash-1 {
                algo = "sha1";
            };
        };
        fdt-smk-k26-revA-sck-kv-g-revB.dtb {
            description = "Flattened device tree blob - smk-k26-revA-sck-kv-g-revB";
            data = /incbin/("../dtbs/xilinx/smk-k26-revA-sck-kv-g-revB.dtb");
            type = "flat_dt";
            arch = "arm64";
            compression = "none";
            load = <0x44000000>;
            hash-1 {
                algo = "sha1";
            };
        };
    };

    configurations {
        default = "conf-zynqmp-smk-k26-revA";
        conf-zynqmp-smk-k26-revA {
            description = "Boot Ubuntu on kria SOM";
            kernel = "kernel-1";
            ramdisk = "ramdisk-1";
            fdt = "fdt-zynqmp-smk-k26-revA.dtb";
            hash-1 {
                algo = "sha1";
            };
        };
        conf-smk-k26-revA-sck-kr-g-revA {
            description = "Boot Ubuntu on kria SOM";
            kernel = "kernel-1";
            ramdisk = "ramdisk-1";
            fdt = "fdt-smk-k26-revA-sck-kr-g-revA.dtb";
            hash-1 {
                algo = "sha1";
            };
        };
        conf-smk-k26-revA-sck-kv-g-revA {
            description = "Boot Ubuntu on kria SOM";
            kernel = "kernel-1";
            ramdisk = "ramdisk-1";
            fdt = "fdt-smk-k26-revA-sck-kv-g-revA.dtb";
            hash-1 {
                algo = "sha1";
            };
        };
        conf-smk-k26-revA-sck-kr-g-revB {
            description = "Boot Ubuntu on kria SOM";
            kernel = "kernel-1";
            ramdisk = "ramdisk-1";
            fdt = "fdt-smk-k26-revA-sck-kr-g-revB.dtb";
            hash-1 {
                algo = "sha1";
            };
        };
        conf-smk-k26-revA-sck-kv-g-revB {
            description = "Boot Ubuntu on kria SOM";
            kernel = "kernel-1";
            ramdisk = "ramdisk-1";
            fdt = "fdt-smk-k26-revA-sck-kv-g-revB.dtb";
            hash-1 {
                algo = "sha1";
            };
        };
        zcu {
            description = "Boot Ubuntu on zcu board";
            kernel = "kernel-1";
            ramdisk = "ramdisk-1";
            hash-1 {
                algo = "sha1";
            };
        };
    };
};
```

## ubuntu/pensando-dsc-drivers/Kconfig
```kconfig
if ARCH_PENSANDO

config IONIC_MNIC
	tristate "Pensando ionic mnic driver"
	help
	  Pensando ionic mnic driver. This is intended to run on
	  the card, not on the host.

	  If you don't know what to do here, say N.

config MDEV
	tristate "Pensando mdev driver"
	help
	  Pensando driver that listens for ioctl() commands from
	  userland to start and stop the network interface ports/

	  If you don't know what to do here, say N.

config MNET_UIO_PDRV_GENIRQ
	tristate "Pensando mnet userspace I/O platform driver with generic IRQ handling code"
	help
	  Pensando specific platform driver for Userspace I/O devices,
	  including generic interrupt handling code. Shared interrupts
	  are not supported.

	  This kernel driver requires that the matching userspace driver
	  handles interrupts in a special way. Userspace is responsible
	  for acknowledging the hardware device if needed, and re-enabling
	  interrupts in the interrupt controller using the write() syscall.

	  If you don't know what to do here, say N.
endif
```

## ubuntu/provencore/drivers/provencore/Kconfig
```kconfig
menu "Provencore drivers"

source "ubuntu/provencore/drivers/provencore/ree/Kconfig"

endmenu
```
