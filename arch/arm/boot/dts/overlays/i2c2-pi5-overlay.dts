/dts-v1/;
/plugin/;

/{
	compatible = "brcm,bcm2712";

	fragment@0 {
		target = <&i2c2>;
		frag0: __overlay__ {
			status = "okay";
			clock-frequency = <100000>;
		};
	};

	fragment@1 {
		target = <&frag0>;
		__overlay__ {
			pinctrl-0 = <&rp1_i2c2_4_5>;
		};
	};

	fragment@2 {
		target = <&frag0>;
		__dormant__ {
			pinctrl-0 = <&rp1_i2c2_12_13>;
		};
	};

	__overrides__ {
		pins_4_5 = <0>,"+1-2";
		pins_12_13 = <0>,"-1+2";
		baudrate = <&frag0>, "clock-frequency:0";
	};
};
